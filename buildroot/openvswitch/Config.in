## buildroot/openvswitch/Config.in
```kconfig
config BR2_PACKAGE_OPENVSWITCH
        bool "openvswitch"
        select BR2_PACKAGE_BRIDGE_UTILS
        select BR2_PACKAGE_OPENSSL
        select BR2_PACKAGE_PYTHON
        select BR2_PACKAGE_PYTHON_SIMPLEJSON
        depends on BR2_TOOLCHAIN_USES_GLIBC
        help
          Open vSwitch is a multilayer software switch licensed under the open source Apache 2 license.
          Our goal is to implement a production quality switch platform that supports standard management
          interfaces and opens the forwarding functions to programmatic extension and control.

          http://openvswitch.org
```
